## boards/shields/fumblr/Kconfig.defconfig
```kconfig
if SHIELD_FUMBLR_LEFT

config ZMK_KEYBOARD_NAME
	default "Fumblr"

config ZMK_SPLIT_BLE_ROLE_CENTRAL
	default y

endif

if SHIELD_FUMBLR_RIGHT

config ZMK_KEYBOARD_NAME
	default "Fumblr Right"
	
endif

if SHIELD_FUMBLR_LEFT || SHIELD_FUMBLR_RIGHT

config ZMK_SPLIT
	default y

endif
```

## boards/shields/fumblr/Kconfig.shield
```kconfig
# Copyright (c) 2020 Pete Johanson
# SPDX-License-Identifier: MIT

config SHIELD_FUMBLR_LEFT
	def_bool $(shields_list_contains,fumblr_left)

config SHIELD_FUMBLR_RIGHT
	def_bool $(shields_list_contains,fumblr_right)
```
